#include <SoftwareSerial.h>
//#include <DFPlayer_Mini_Mp3.h>
#include <Adafruit_SSD1306.h>


#define nombreDePixelsEnLargeur 128         // Taille de l'écran OLED, en pixel, au niveau de sa largeur
#define nombreDePixelsEnHauteur 64          // Taille de l'écran OLED, en pixel, au niveau de sa hauteur
#define brocheResetOLED         -1          // Reset de l'OLED partagé avec l'Arduino (d'où la valeur à -1, et non un numéro de pin)
#define adresseI2CecranOLED     0x3C        // Adresse de "mon" écran OLED sur le bus i2c (généralement égal à 0x3C ou 0x3D)

Adafruit_SSD1306 ecranOLED(nombreDePixelsEnLargeur, nombreDePixelsEnHauteur, &Wire, brocheResetOLED);


const unsigned char epd_bitmap_nombre1 [] PROGMEM = {
  0x00, 0x00, 0x7f, 0x00, 0x00, 0x00, 0x7f, 0x00, 0x00, 0x00, 0xff, 0x00, 0x00, 0x01, 0xff, 0x00, 
  0x00, 0x03, 0xff, 0x00, 0x00, 0x07, 0xff, 0x00, 0x00, 0x1f, 0xff, 0x00, 0x00, 0x7f, 0xff, 0x00, 
  0x00, 0xff, 0xff, 0x00, 0x00, 0xff, 0xff, 0x00, 0x00, 0xff, 0xff, 0x00, 0x00, 0xff, 0xff, 0x00, 
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  0x00, 0x00, 0xff, 0x00, 0x00, 0x00, 0xff, 0x00, 0x00, 0x00, 0xff, 0x00, 0x00, 0x00, 0xff, 0x00
};


const unsigned char epd_bitmap_nombre2 [] PROGMEM = {
  0x00, 0x07, 0xf0, 0x00, 0x00, 0x3f, 0xfe, 0x00, 0x00, 0x7f, 0xff, 0x00, 0x00, 0xff, 0xff, 0x80, 
  0x01, 0xff, 0xff, 0xc0, 0x01, 0xff, 0xff, 0xc0, 0x03, 0xff, 0xff, 0xe0, 0x03, 0xfc, 0x1f, 0xe0, 
  0x03, 0xfc, 0x1f, 0xe0, 0x03, 0xf8, 0x1f, 0xe0, 0x03, 0xf8, 0x1f, 0xe0, 0x00, 0x00, 0x1f, 0xe0, 
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  0x07, 0xff, 0xff, 0xe0, 0x07, 0xff, 0xff, 0xe0, 0x07, 0xff, 0xff, 0xe0, 0x07, 0xff, 0xff, 0xe0
};
const unsigned char epd_bitmap_nombre3 [] PROGMEM = {
  0x00, 0x0f, 0xe0, 0x00, 0x00, 0x3f, 0xfc, 0x00, 0x00, 0xff, 0xfe, 0x00, 0x00, 0xff, 0xff, 0x00, 
  0x01, 0xff, 0xff, 0x80, 0x03, 0xff, 0xff, 0x80, 0x03, 0xff, 0xff, 0xc0, 0x03, 0xf8, 0x3f, 0xc0, 
  0x07, 0xf8, 0x3f, 0xc0, 0x03, 0xf8, 0x3f, 0xc0, 0x00, 0x00, 0x7f, 0xc0, 0x00, 0x00, 0xff, 0x80, 
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  0x01, 0xff, 0xff, 0x00, 0x00, 0xff, 0xfe, 0x00, 0x00, 0x3f, 0xfc, 0x00, 0x00, 0x0f, 0xe0, 0x00
};
const unsigned char epd_bitmap_nombre4 [] PROGMEM = {
  0x00, 0x00, 0x04, 0x00, 0x00, 0x00, 0x1f, 0x00, 0x00, 0x00, 0x3f, 0x80, 0x00, 0x00, 0x7f, 0x80, 
  0x00, 0x00, 0xff, 0x80, 0x00, 0x01, 0xff, 0x80, 0x00, 0x03, 0xff, 0x80, 0x00, 0x07, 0xff, 0x80, 
  0x00, 0x0f, 0xff, 0x80, 0x00, 0x1f, 0xff, 0x80, 0x00, 0x3f, 0xff, 0x80, 0x00, 0x7f, 0xff, 0x80, 
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  0x00, 0x00, 0x1f, 0x80, 0x00, 0x00, 0x1f, 0x00, 0x00, 0x00, 0x1f, 0x00, 0x00, 0x00, 0x04, 0x00
};
const unsigned char epd_bitmap_nombre5 [] PROGMEM = {
  0x00, 0x7f, 0xff, 0xc0, 0x00, 0xff, 0xff, 0xc0, 0x00, 0xff, 0xff, 0xc0, 0x00, 0xff, 0xff, 0xc0, 
  0x00, 0xff, 0xff, 0xc0, 0x00, 0xff, 0xff, 0xc0, 0x01, 0xff, 0xff, 0xc0, 0x01, 0xfe, 0x00, 0x00, 
  0x01, 0xfe, 0x00, 0x00, 0x01, 0xfc, 0x00, 0x00, 0x01, 0xff, 0xf8, 0x00, 0x03, 0xff, 0xfe, 0x00, 
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  0x01, 0xff, 0xff, 0x00, 0x00, 0xff, 0xfe, 0x00, 0x00, 0x3f, 0xfc, 0x00, 0x00, 0x0f, 0xe0, 0x00
};
const unsigned char epd_bitmap_nombre6 [] PROGMEM = {
  0x00, 0x00, 0xe0, 0x00, 0x00, 0x01, 0xf0, 0x00, 0x00, 0x03, 0xf8, 0x00, 0x00, 0x07, 0xf8, 0x00, 
  0x00, 0x0f, 0xf0, 0x00, 0x00, 0x1f, 0xe0, 0x00, 0x00, 0x1f, 0xc0, 0x00, 0x00, 0x3f, 0x80, 0x00, 
  0x00, 0x7f, 0x00, 0x00, 0x00, 0x7f, 0x00, 0x00, 0x00, 0xfe, 0x00, 0x00, 0x00, 0xff, 0xe0, 0x00, 
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  0x00, 0xff, 0xff, 0x00, 0x00, 0x7f, 0xfe, 0x00, 0x00, 0x1f, 0xf8, 0x00, 0x00, 0x07, 0xe0, 0x00
};

const unsigned char epd_bitmap_nombre7 [] PROGMEM = {
  0x01, 0xff, 0xff, 0x80, 0x03, 0xff, 0xff, 0xc0, 0x03, 0xff, 0xff, 0xc0, 0x03, 0xff, 0xff, 0xc0, 
  0x01, 0xff, 0xff, 0xc0, 0x00, 0xff, 0xff, 0x80, 0x00, 0x00, 0x1f, 0x80, 0x00, 0x00, 0x3f, 0x00, 
  0x00, 0x00, 0x3f, 0x00, 0x00, 0x00, 0x7e, 0x00, 0x00, 0x00, 0x7e, 0x00, 0x00, 0x00, 0xfe, 0x00, 
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  0x00, 0x7e, 0x00, 0x00, 0x00, 0x7e, 0x00, 0x00, 0x00, 0x7c, 0x00, 0x00, 0x00, 0x38, 0x00, 0x00
};

const unsigned char epd_bitmap_nombre8 [] PROGMEM = {
  0x00, 0x00, 0x00, 0x00, 0x00, 0x00, 0x00, 0x00, 0x00, 0x00, 0x00, 0x00, 0x00, 0x00, 0x00, 0x00, 
  0x00, 0x1f, 0xf8, 0x00, 0x00, 0x3f, 0xfc, 0x00, 0x00, 0x7f, 0xfe, 0x00, 0x00, 0x7f, 0xfe, 0x00, 
  0x00, 0xfc, 0x3f, 0x00, 0x00, 0xfc, 0x3f, 0x00, 0x00, 0xfc, 0x3f, 0x00, 0x00, 0xfc, 0x3f, 0x00, 
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  0x00, 0x00, 0x00, 0x00, 0x00, 0x00, 0x00, 0x00, 0x00, 0x00, 0x00, 0x00, 0x00, 0x00, 0x00, 0x00
};

const unsigned char epd_bitmap_nombre9 [] PROGMEM = {
  0x00, 0x07, 0xe0, 0x00, 0x00, 0x1f, 0xf8, 0x00, 0x00, 0x7f, 0xfe, 0x00, 0x00, 0xff, 0xff, 0x00, 
  0x01, 0xff, 0xff, 0x80, 0x01, 0xff, 0xff, 0x80, 0x03, 0xf8, 0x1f, 0xc0, 0x03, 0xf0, 0x0f, 0xc0, 
  0x03, 0xf0, 0x0f, 0xc0, 0x03, 0xe0, 0x07, 0xc0, 0x07, 0xe0, 0x07, 0xe0, 0x03, 0xe0, 0x07, 0xc0, 
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  0x00, 0x1f, 0xe0, 0x00, 0x00, 0x1f, 0xc0, 0x00, 0x00, 0x0f, 0x80, 0x00, 0x00, 0x07, 0x00, 0x00
};

#define largeurDeLimage           32          // Largeur de l'image à afficher, en pixels
#define hauteurDeLimage           32          // Hauteur de l'image à afficher, en pixels
int rangee[] = {9, 8, 7, 6};
int colonne[] = {10, 11, 12, 13};
int col_scan;
SoftwareSerial mySerial(0, 1); // RX, TX
void setup()
{
 Serial.begin(9600);
  mySerial.begin (9600);
  /*mp3_set_serial (mySerial);  //set softwareSerial for DFPlayer-mini mp3 module 
  mp3_set_volume (25);
  mp3_set_device(2);*/


  // Initialisation de l'écran OLED
  if(!ecranOLED.begin(SSD1306_SWITCHCAPVCC, adresseI2CecranOLED))
    while(1);                               // Arrêt du programme (boucle infinie) si échec d'initialisation
  





 for (int i = 0; i <= 3; i++)
 {
 // Initialisation des broches
 pinMode(rangee[i], OUTPUT);
 pinMode(colonne[i], INPUT);
 digitalWrite(colonne[i], HIGH);
 }
 Serial.println("====== Clavier pret ======");
 // start ();
}
void loop()
{
   // Regarde si un bouton est enfoncé
   for (int i = 0; i <= 3; i++)
   {
     digitalWrite(rangee[0], HIGH);
     digitalWrite(rangee[1], HIGH);
     digitalWrite(rangee[2], HIGH);
     digitalWrite(rangee[3], HIGH);
     digitalWrite(rangee[i], LOW);
       for (int j = 0; j <= 3; j++)
       {
       col_scan = digitalRead(colonne[j]);
       if (col_scan == LOW)
         {
         // Lorsqu'un bouton est enfoncé, appel de la fonction toucherBouton
         // pour savoir quel bouton est enfoncé
         toucherBouton(i, j);
         delay(300);
        }
     }
   }
}


void OledDisplay(int number,const unsigned char* imageAafficher)
{
      ecranOLED.clearDisplay();  
     ecranOLED.setCursor(0, 15);  
     ecranOLED.setTextColor(SSD1306_WHITE); 
     ecranOLED.print("Chiffre  ");
     ecranOLED.setCursor(50, 15);  
     ecranOLED.setTextColor(SSD1306_WHITE); 
     ecranOLED.print(number);
     ecranOLED.drawBitmap(
    (ecranOLED.width()  - largeurDeLimage ) / 2,      // Position de l'extrême "gauche" de l'image (pour centrage écran, ici)
    (ecranOLED.height() - hauteurDeLimage) / 2,       // Position de l'extrême "haute" de l'image (pour centrage écran, ici)
    imageAafficher,
    largeurDeLimage,
    hauteurDeLimage,
    SSD1306_WHITE);  

   
    ecranOLED.display();
      
}

void start () 
{
   //mp3_play (1,11);
   // delay (7000);
}


// Fonction de reconnaissance et affichage du bouton enfoncé
void toucherBouton(int i, int j)
{
   if (i == 0 && j == 0) // Bouton S1 enfoncé
   {
    Serial.println("S1");
   // mp3_play (1);
   // delay (7000);

 OledDisplay(1,epd_bitmap_nombre1) ; 
    
   }
   if (i == 0 && j == 1) // Bouton S2 enfoncé
   {
    Serial.println("S2");
   //  mp3_play (2);
 OledDisplay(2,epd_bitmap_nombre2) ;   
   }
  
   if (i == 0 && j == 2) // Bouton S3 enfoncé
   {
    Serial.println("S3");
   // mp3_play (3);
   // delay (7000);
 OledDisplay(3,epd_bitmap_nombre3) ; 
   }
   
   if (i == 0 && j == 3) // Bouton S4 enfoncé
   {
    Serial.println("S4");
    //mp3_play (4);
    //delay (7000);
    OledDisplay(4,epd_bitmap_nombre4) ; 
     
   }
   
   if (i == 1 && j == 0) // Bouton S5 enfoncé
   {
    Serial.println("S5");
   // mp3_play (5);
   // delay (7000);
        OledDisplay(5,epd_bitmap_nombre5) ; 
   }
   
   if (i == 1 && j == 1) // Bouton S6 enfoncé
   {
    Serial.println("S6");
   // mp3_play (6);
    //delay (7000);
         OledDisplay(6,epd_bitmap_nombre6) ; 
   }
   
   if (i == 1 && j == 2) // Bouton S7 enfoncé
   {
    Serial.println("S7");
  //  mp3_play (7);
   // delay (7000);
        OledDisplay(7,epd_bitmap_nombre7) ; 
   }
   
   if (i == 1 && j == 3) // Bouton S8 enfoncé
   {
    Serial.println("S8");
  //  mp3_play (8);
   // delay (7000);
        OledDisplay(8,epd_bitmap_nombre8) ; 
   }

   if (i == 2 && j == 0) // Bouton S9 enfoncé
   {
    Serial.println("S9");
    //mp3_play (9);
    //delay (7000);
         OledDisplay(9,epd_bitmap_nombre9) ; 
   }
   
   if (i == 2 && j == 1) // Bouton S10 enfoncé
   {
    Serial.println("S10");
   //  mp3_play (10);
     //delay (7000);
   }
  
   if (i == 2 && j == 2) // Bouton S11 enfoncé
   Serial.println("S11");
   if (i == 2 && j == 3) // Bouton S12 enfoncé
   Serial.println("S12");
   if (i == 3 && j == 0) // Bouton S13 enfoncé
   Serial.println("S13");
   if (i == 3 && j == 1) // Bouton S14 enfoncé
   Serial.println("S14");
   if (i == 3 && j == 2) // Bouton S15 enfoncé
   Serial.println("S15");
   if (i == 3 && j == 3) // Bouton S16 enfoncé
   Serial.println("S16");
}
